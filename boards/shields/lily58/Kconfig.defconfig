## boards/shields/lily58/Kconfig.defconfig
```kconfig
# SPDX-License-Identifier: MIT

if SHIELD_LILY58_DONGLE

# Max 16 characters in keyboard name
config ZMK_KEYBOARD_NAME
    default "Lily58"

config ZMK_SPLIT_ROLE_CENTRAL
    default y

config ZMK_SPLIT
    default y

# Left and right halves -> 2 peripherals
config ZMK_SPLIT_BLE_CENTRAL_PERIPHERALS
    default 2

# 2 peripherals + 5 BT profiles
config BT_MAX_CONN
    default 7

# Same as BT_MAX_CONN
config BT_MAX_PAIRED
    default 7

endif
```
